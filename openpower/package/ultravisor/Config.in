## openpower/package/ultravisor/Config.in
```kconfig
menu "Ultravisor"

config BR2_PACKAGE_ULTRAVISOR
	bool "ultravisor"
	depends on BR2_powerpc64le
        default N if (BR2_OPENPOWER_PLATFORM)
	help
	  Build ultravisor POWER firmware

if BR2_PACKAGE_ULTRAVISOR

choice
	prompt "Ultravisor version"
	default BR2_ULTRAVISOR_LATEST_VERSION

config BR2_ULTRAVISOR_LATEST_VERSION
	bool "Use ultravisor stable"

config BR2_ULTRAVISOR_CUSTOM_VERSION
	bool "Custom version"

endchoice

config BR2_ULTRAVISOR_CUSTOM_VERSION_VALUE
	string "Ultravisor version"
	depends on BR2_ULTRAVISOR_CUSTOM_VERSION

config BR2_ULTRAVISOR_VERSION
	string
	default "v0.9" if BR2_ULTRAVISOR_LATEST_VERSION
	default BR2_ULTRAVISOR_CUSTOM_VERSION_VALUE \
		if BR2_ULTRAVISOR_CUSTOM_VERSION

config BR2_ULTRAVISOR_CUSTOM_GIT
	bool "Custom git repository"

config BR2_ULTRAVISOR_CUSTOM_REPO_URL
	string "URL of custom repository"
	depends on BR2_ULTRAVISOR_CUSTOM_GIT

endif

endmenu
```
